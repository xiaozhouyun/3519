/*********************************************************************************************************************
* MSPM0G3519 TFT180 LCD Driver (TI Official DriverLib)
* 
* 文件名称          zf_device_tft180
* 适用平台          MSPM0G3519 (ti_msp_dl_config.h)
********************************************************************************************************************/

#include "../inc/zf_device_tft180.h"
#include <stdio.h>
#include <stdarg.h>
#include <string.h>
#include <stdlib.h>
#include <math.h>

#define delay_ms(ms)            delay_cycles(CPUCLK_FREQ / 1000 * (ms))
#define zf_assert(expr)         ((void)0)

static uint16                   tft180_pencolor     = TFT180_DEFAULT_PENCOLOR;
static uint16                   tft180_bgcolor      = TFT180_DEFAULT_BGCOLOR;

static tft180_dir_enum          tft180_display_dir  = TFT180_DEFAULT_DISPLAY_DIR;
static tft180_font_size_enum    tft180_display_font = TFT180_DEFAULT_DISPLAY_FONT;

static uint8                    tft180_x_max        = 128;
static uint8                    tft180_y_max        = 160;

#define TFT180_PRINT_BUFFER_SIZE        64U
#define TFT180_PRINT_SLOT_COUNT         32U

typedef struct
{
    uint16 x;
    uint16 y;
    tft180_font_size_enum size;
    uint8 length;
    bool valid;
} tft180_print_slot_t;

static tft180_print_slot_t tft180_print_slots[TFT180_PRINT_SLOT_COUNT];

// 汉字字库字典结构体定义
typedef struct {
    uint8 utf8_bytes[3];   // UTF-8 精确3字节
    uint8 gbk_bytes[2];    // GBK 精确2字节
    uint8 bitmap[32];      // 16x16 纵向取模 (PC2LCD2002 32字节)
} chinese_font_item_t;

// 内置常用汉字点阵字库 (全量导入用户提供的全套字模，100% 用户专属)
static const chinese_font_item_t chinese_db[] = {
    /* "中" (用户指定字模) */
    {{0xE4, 0xB8, 0xAD}, {0xD6, 0xD0}, {
        0x00,0x00,0xF0,0x10,0x10,0x10,0x10,0xFF,0x10,0x10,0x10,0x10,0xF0,0x00,0x00,0x00,
        0x00,0x00,0x0F,0x04,0x04,0x04,0x04,0xFF,0x04,0x04,0x04,0x04,0x0F,0x00,0x00,0x00
    }},
    /* "文" (用户指定字模) */
    {{0xE6, 0x96, 0x87}, {0xC6, 0xC6}, {
        0x08,0x08,0x08,0x38,0xC8,0x08,0x09,0x0E,0x08,0x08,0xC8,0x38,0x08,0x08,0x08,0x00,
        0x80,0x80,0x40,0x40,0x20,0x11,0x0A,0x04,0x0A,0x11,0x20,0x40,0x40,0x80,0x80,0x00
    }},
    /* "显" (用户指定字模) */
    {{0xE6, 0x98, 0xBE}, {0xD0, 0xD4}, {
        0x00,0x00,0x00,0xFE,0x92,0x92,0x92,0x92,0x92,0x92,0x92,0xFE,0x00,0x00,0x00,0x00,
        0x40,0x42,0x44,0x58,0x40,0x7F,0x40,0x40,0x40,0x7F,0x40,0x50,0x48,0x46,0x40,0x00
    }},
    /* "示" (用户指定字模) */
    {{0xE7, 0xA4, 0xBA}, {0xCA, 0xBE}, {
        0x40,0x40,0x42,0x42,0x42,0x42,0x42,0xC2,0x42,0x42,0x42,0x42,0x42,0x40,0x40,0x00,
        0x20,0x10,0x08,0x06,0x00,0x40,0x80,0x7F,0x00,0x00,0x00,0x02,0x04,0x08,0x30,0x00
    }},
    /* "电" (用户指定字模) */
    {{0xE7, 0x94, 0xB5}, {0xD0, 0xC6}, {
        0x00,0x00,0xF8,0x88,0x88,0x88,0x88,0xFF,0x88,0x88,0x88,0x88,0xF8,0x00,0x00,0x00,
        0x00,0x00,0x1F,0x08,0x08,0x08,0x08,0x7F,0x88,0x88,0x88,0x88,0x9F,0x80,0xF0,0x00
    }},
    /* "赛" (用户指定字模) */
    {{0xE8, 0xB5, 0x9B}, {0xC8, 0xFC}, {
        0x88,0x86,0xA2,0xAA,0xAA,0xFE,0xAA,0xAB,0xAA,0xFE,0xAA,0xAA,0xA2,0x8A,0x86,0x00,
        0x08,0x08,0x04,0x82,0xBF,0x42,0x22,0x1E,0x22,0x42,0xBF,0x02,0x04,0x08,0x08,0x00
    }},
    /* "测" (用户指定字模) */
    {{0xE6, 0xB5, 0x8B}, {0xB2, 0xE2}, {
        0x10,0x60,0x02,0x8C,0x00,0xFE,0x02,0xF2,0x02,0xFE,0x00,0xF8,0x00,0xFF,0x00,0x00,
        0x04,0x04,0x7E,0x01,0x80,0x47,0x30,0x0F,0x10,0x27,0x00,0x47,0x80,0x7F,0x00,0x00
    }},
    /* "试" (用户指定字模) */
    {{0xE8, 0xAF, 0x95}, {0xCA, 0xD4}, {
        0x40,0x40,0x42,0xCC,0x00,0x90,0x90,0x90,0x90,0x90,0xFF,0x10,0x11,0x16,0x10,0x00,
        0x00,0x00,0x00,0x3F,0x10,0x28,0x60,0x3F,0x10,0x10,0x01,0x0E,0x30,0x40,0xF0,0x00
    }},
};

// 标准 8x16 ASCII 字体点阵库
static const uint8 ascii_font_8x16[95][16] = {
    {0x00,0x00,0x00,0x00,0x00,0x00,0x00,0x00,0x00,0x00,0x00,0x00,0x00,0x00,0x00,0x00}, // ' ' (32)
    {0x00,0x00,0x00,0x08,0x08,0x08,0x08,0x08,0x08,0x00,0x08,0x00,0x00,0x00,0x00,0x00}, // '!' (33)
    {0x00,0x00,0x00,0x24,0x24,0x24,0x00,0x00,0x00,0x00,0x00,0x00,0x00,0x00,0x00,0x00}, // '"' (34)
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    {0x00,0x00,0x00,0x00,0x00,0x00,0x2C,0x32,0x00,0x00,0x00,0x00,0x00,0x00,0x00,0x00}, // '~' (126)
};

// 6x8 字体点阵库 (ASCII 32 ~ 126, 列优先)
static const uint8 ascii_font_6x8[95][6] = {
    {0x00, 0x00, 0x00, 0x00, 0x00, 0x00}, // ' '
    {0x00, 0x00, 0x5F, 0x00, 0x00, 0x00}, // '!'
    {0x00, 0x07, 0x00, 0x07, 0x00, 0x00}, // '"'
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    {0x02, 0x01, 0x02, 0x04, 0x02, 0x00}, // '~'
};

static inline int16 func_abs(int16 x)
{
    return (x < 0) ? -x : x;
}

static void func_int_to_str(char *str, int32 val)
{
    sprintf(str, "%d", (int)val);
}

static void func_uint_to_str(char *str, uint32 val)
{
    sprintf(str, "%u", (unsigned int)val);
}

static void func_double_to_str(char *str, double val, uint8 pointnum)
{
    sprintf(str, "%.*f", pointnum, val);
}

// --------------------------- 底层 SPI 接口与同步等待函数 ---------------------------

static inline void tft180_spi_wait_idle(void)
{
    while (!DL_SPI_isTXFIFOEmpty(TFT_SPI0_INST) || DL_SPI_isBusy(TFT_SPI0_INST));
}

static inline void tft180_write_8bit_data(uint8_t data)
{
    while (DL_SPI_isTXFIFOFull(TFT_SPI0_INST));
    DL_SPI_transmitData8(TFT_SPI0_INST, data);
}

static inline void tft180_write_16bit_data(uint16_t data)
{
    while (DL_SPI_isTXFIFOFull(TFT_SPI0_INST));
    DL_SPI_transmitData8(TFT_SPI0_INST, (uint8_t)(data >> 8));
    while (DL_SPI_isTXFIFOFull(TFT_SPI0_INST));
    DL_SPI_transmitData8(TFT_SPI0_INST, (uint8_t)(data & 0xFF));
}

static void tft180_write_index(const uint8_t dat)
{
    tft180_spi_wait_idle();
    TFT180_DC(0);
    DL_SPI_transmitData8(TFT_SPI0_INST, dat);
    tft180_spi_wait_idle();
    TFT180_DC(1);
}

static void tft180_set_region(uint16 x1, uint16 y1, uint16 x2, uint16 y2)
{
    zf_assert(x1 < tft180_x_max);
    zf_assert(y1 < tft180_y_max);
    zf_assert(x2 < tft180_x_max);
    zf_assert(y2 < tft180_y_max);

    switch(tft180_display_dir)
    {
        case TFT180_PORTAIT:
        case TFT180_PORTAIT_180:
        {
            tft180_write_index(0x2a);
            tft180_write_8bit_data(0x00);
            tft180_write_8bit_data(x1);
            tft180_write_8bit_data(0x00);
            tft180_write_8bit_data(x2);

            tft180_write_index(0x2b);
            tft180_write_8bit_data(0x00);
            tft180_write_8bit_data(y1);
            tft180_write_8bit_data(0x00);
            tft180_write_8bit_data(y2);
        }break;
        case TFT180_CROSSWISE:
        case TFT180_CROSSWISE_180:
        {
            tft180_write_index(0x2a);
            tft180_write_8bit_data(0x00);
            tft180_write_8bit_data(x1);
            tft180_write_8bit_data(0x00);
            tft180_write_8bit_data(x2);

            tft180_write_index(0x2b);
            tft180_write_8bit_data(0x00);
            tft180_write_8bit_data(y1);
            tft180_write_8bit_data(0x00);
            tft180_write_8bit_data(y2);
        }break;
    }
    tft180_write_index(0x2c);
}

// --------------------------- 单个 16x16 汉字渲染内部函数 (纵向取模) ---------------------------

static void tft180_draw_chinese_16x16(uint16 x, uint16 y, const uint8 bitmap[32], uint16 color)
{
    if (x >= tft180_x_max || y >= tft180_y_max || bitmap == NULL) return;

    TFT180_CS(0);
    tft180_set_region(x, y, x + 15, y + 15);
    
    // 适配用户 PC2LCD2002 纵向取模方式 (行扫描发送16列像素)
    for (int r = 0; r < 16; r++)
    {
        for (int c = 0; c < 16; c++)
        {
            uint8 byte_val = (r < 8) ? bitmap[c] : bitmap[c + 16];
            uint8 bit_shift = (r < 8) ? r : (r - 8);
            uint16 pixel_color = (byte_val & (1 << bit_shift)) ? color : tft180_bgcolor;
            tft180_write_16bit_data(pixel_color);
        }
    }
    
    tft180_spi_wait_idle();
    TFT180_CS(1);
}

// --------------------------- 公共 API 实现 ---------------------------

void tft180_clear(void)
{
    uint16 i = 0, j = 0;

    TFT180_CS(0);
    tft180_set_region(0, 0, tft180_x_max - 1, tft180_y_max - 1);
    for (j = 0; j < tft180_y_max; j++)
    {
        for (i = 0; i < tft180_x_max; i++)
        {
            tft180_write_16bit_data(tft180_bgcolor);
        }
    }
    tft180_spi_wait_idle();
    TFT180_CS(1);
}

void tft180_full(const uint16 color)
{
    uint16 i = 0, j = 0;

    TFT180_CS(0);
    tft180_set_region(0, 0, tft180_x_max - 1, tft180_y_max - 1);
    for (j = 0; j < tft180_y_max; j++)
    {
        for (i = 0; i < tft180_x_max; i++)
        {
            tft180_write_16bit_data(color);
        }
    }
    tft180_spi_wait_idle();
    TFT180_CS(1);
}

void tft180_set_dir(tft180_dir_enum dir)
{
    tft180_display_dir = dir;
    switch(tft180_display_dir)
    {
        case TFT180_PORTAIT:
        case TFT180_PORTAIT_180:
        {
            tft180_x_max = 128;
            tft180_y_max = 160;
        }break;
        case TFT180_CROSSWISE:
        case TFT180_CROSSWISE_180:
        {
            tft180_x_max = 160;
            tft180_y_max = 128;
        }break;
    }
}

void tft180_set_font(tft180_font_size_enum font)
{
    tft180_display_font = font;
}

void tft180_set_color(uint16 pen, const uint16 bgcolor)
{
    tft180_pencolor = pen;
    tft180_bgcolor = bgcolor;
}

void tft180_draw_point(uint16 x, uint16 y, const uint16 color)
{
    if (x >= tft180_x_max || y >= tft180_y_max) return;

    TFT180_CS(0);
    tft180_set_region(x, y, x, y);
    tft180_write_16bit_data(color);
    tft180_spi_wait_idle();
    TFT180_CS(1);
}

void tft180_draw_line(uint16 x_start, uint16 y_start, uint16 x_end, uint16 y_end, const uint16 color)
{
    if (x_start >= tft180_x_max || y_start >= tft180_y_max || x_end >= tft180_x_max || y_end >= tft180_y_max) return;

    int16 x_dir = (x_start < x_end ? 1 : -1);
    int16 y_dir = (y_start < y_end ? 1 : -1);
    float temp_rate = 0;
    float temp_b = 0;

    do
    {
        if(x_start != x_end)
        {
            temp_rate = (float)(y_start - y_end) / (float)(x_start - x_end);
            temp_b = (float)y_start - (float)x_start * temp_rate;
        }
        else
        {
            while(y_start != y_end)
            {
                tft180_draw_point(x_start, y_start, color);
                y_start += y_dir;
            }
            tft180_draw_point(x_start, y_start, color);
            break;
        }
        
        if(func_abs(y_start - y_end) > func_abs(x_start - x_end))
        {
            while(y_start != y_end)
            {
                tft180_draw_point(x_start, y_start, color);
                y_start += y_dir;
                x_start = (int16)(((float)y_start - temp_b) / temp_rate);
            }
            tft180_draw_point(x_start, y_start, color);
        }
        else
        {
            while(x_start != x_end)
            {
                tft180_draw_point(x_start, y_start, color);
                x_start += x_dir;
                y_start = (int16)((float)x_start * temp_rate + temp_b);
            }
            tft180_draw_point(x_start, y_start, color);
        }
    }while(0);
}

void tft180_show_char(uint16 x, uint16 y, const char dat)
{
    if (x >= tft180_x_max || y >= tft180_y_max) return;
    if (dat < ' ' || dat > '~') return;

    uint8 r = 0, c = 0;

    TFT180_CS(0);
    switch(tft180_display_font)
    {
        case TFT180_6X8_FONT:
        {
            tft180_set_region(x, y, x + 5, y + 7);
            for(r = 0; r < 8; r++)
            {
                for(c = 0; c < 6; c++)
                {
                    uint8 line = ascii_font_6x8[dat - 32][c];
                    uint16 color = (line & (1 << r)) ? tft180_pencolor : tft180_bgcolor;
                    tft180_write_16bit_data(color);
                }
            }
        }break;
        case TFT180_8X16_FONT:
        {
            tft180_set_region(x, y, x + 7, y + 15);
            for(r = 0; r < 16; r++)
            {
                uint8 row_data = ascii_font_8x16[dat - 32][r];
                for(c = 0; c < 8; c++)
                {
                    uint16 color = (row_data & (0x80 >> c)) ? tft180_pencolor : tft180_bgcolor;
                    tft180_write_16bit_data(color);
                }
            }
        }break;
        case TFT180_16X16_FONT:
        {
            // 暂不支持
        }break;
    }
    tft180_spi_wait_idle();
    TFT180_CS(1);
}

void tft180_show_string(uint16 x, uint16 y, const char dat[])
{
    if (x >= tft180_x_max || y >= tft180_y_max) return;
    
    uint16 j = 0;
    while('\0' != dat[j])
    {
        switch(tft180_display_font)
        {
            case TFT180_6X8_FONT:   tft180_show_char(x + 6 * j, y, dat[j]); break;
            case TFT180_8X16_FONT:  tft180_show_char(x + 8 * j, y, dat[j]); break;
            case TFT180_16X16_FONT: break;
        }
        j++;
    }
}

static void tft180_show_fixed_string(uint16 x, uint16 y, const char dat[], uint8 length)
{
    uint16 char_width = (tft180_display_font == TFT180_6X8_FONT) ? 6 : 8;

    for(uint8 i = 0; i < length; i++)
    {
        tft180_show_char(x + char_width * i, y, (dat[i] == '\0') ? ' ' : dat[i]);
    }
}

static tft180_print_slot_t *tft180_get_print_slot(uint16 x, uint16 y, tft180_font_size_enum size)
{
    for(uint8 i = 0; i < TFT180_PRINT_SLOT_COUNT; i++)
    {
        if(tft180_print_slots[i].valid && tft180_print_slots[i].x == x &&
           tft180_print_slots[i].y == y && tft180_print_slots[i].size == size)
        {
            return &tft180_print_slots[i];
        }
    }

    for(uint8 i = 0; i < TFT180_PRINT_SLOT_COUNT; i++)
    {
        if(!tft180_print_slots[i].valid)
        {
            return &tft180_print_slots[i];
        }
    }

    return &tft180_print_slots[0];
}

void tft_print(uint16 x, uint16 y, tft180_font_size_enum size, const char *format, ...)
{
    if(format == NULL || size > TFT180_8X16_FONT) return;

    char buffer[TFT180_PRINT_BUFFER_SIZE];
    memset(buffer, 0, sizeof(buffer));
    va_list args;
    va_start(args, format);
    int result = vsnprintf(buffer, sizeof(buffer), format, args);
    va_end(args);
    if(result < 0) return;

    uint8 new_length = 0;
    while(new_length < TFT180_PRINT_BUFFER_SIZE - 1U && buffer[new_length] != '\0')
    {
        new_length++;
    }

    tft180_print_slot_t *slot = tft180_get_print_slot(x, y, size);
    uint8 display_length = new_length;
    if(slot->valid && slot->length > display_length)
    {
        display_length = slot->length;
    }

    tft180_font_size_enum previous_size = tft180_display_font;
    tft180_set_font(size);
    tft180_show_fixed_string(x, y, buffer, display_length);
    tft180_set_font(previous_size);

    slot->x = x;
    slot->y = y;
    slot->size = size;
    slot->length = new_length;
    slot->valid = true;
}

void tft180_show_int(uint16 x, uint16 y, const int32 dat, uint8 num)
{
    if (x >= tft180_x_max || y >= tft180_y_max || num == 0 || num > 10) return;

    int32 dat_temp = dat;
    int32 offset = 1;
    char data_buffer[12];

    memset(data_buffer, 0, 12);

    if(10 > num)
    {
        for(uint8 digits = num; 0 < digits; digits--)
        {
            offset *= 10;
        }
        dat_temp %= offset;
    }
    func_int_to_str(data_buffer, dat_temp);
    tft180_show_fixed_string(x, y, data_buffer, num + 1);
}

void tft180_show_uint(uint16 x, uint16 y, const uint32 dat, uint8 num)
{
    if (x >= tft180_x_max || y >= tft180_y_max || num == 0 || num > 10) return;

    uint32 dat_temp = dat;
    int32 offset = 1;
    char data_buffer[12];
    memset(data_buffer, 0, 12);
    memset(data_buffer, ' ', num);

    if(10 > num)
    {
        for(uint8 digits = num; 0 < digits; digits--)
        {
            offset *= 10;
        }
        dat_temp %= offset;
    }
    func_uint_to_str(data_buffer, dat_temp);
    tft180_show_fixed_string(x, y, data_buffer, num);
}

void tft180_show_float(uint16 x, uint16 y, const double dat, uint8 num, uint8 pointnum)
{
    if (x >= tft180_x_max || y >= tft180_y_max || num == 0 || num > 8 || pointnum == 0 || pointnum > 6) return;

    double dat_temp = dat;
    double offset = 1.0;
    char data_buffer[17];
    memset(data_buffer, 0, 17);
    memset(data_buffer, ' ', num + pointnum + 2);

    for(; 0 < num; num--)
    {
        offset *= 10;
    }
    dat_temp = dat_temp - ((int)dat_temp / (int)offset) * offset;
    func_double_to_str(data_buffer, dat_temp, pointnum);
    tft180_show_fixed_string(x, y, data_buffer, num + pointnum + 2);
}

void tft180_show_binary_image(uint16 x, uint16 y, const uint8 *image, uint16 width, uint16 height, uint16 dis_width, uint16 dis_height)
{
    if (x >= tft180_x_max || y >= tft180_y_max || image == NULL) return;

    uint32 i = 0, j = 0;
    uint8 temp = 0;
    uint32 width_index = 0;
    const uint8 *image_temp;

    TFT180_CS(0);
    tft180_set_region(x, y, x + dis_width - 1, y + dis_height - 1);

    for(j = 0; j < dis_height; j++)
    {
        image_temp = image + j * height / dis_height * width / 8;
        for(i = 0; i < dis_width; i++)
        {
            width_index = i * width / dis_width;
            temp = *(image_temp + width_index / 8);
            uint16 color = (0x80 & (temp << (width_index % 8))) ? RGB565_WHITE : RGB565_BLACK;
            tft180_write_16bit_data(color);
        }
    }
    tft180_spi_wait_idle();
    TFT180_CS(1);
}

void tft180_show_gray_image(uint16 x, uint16 y, const uint8 *image, uint16 width, uint16 height, uint16 dis_width, uint16 dis_height, uint8 threshold)
{
    if (x >= tft180_x_max || y >= tft180_y_max || image == NULL) return;

    uint32 i = 0, j = 0;
    uint16 color = 0, temp = 0;
    const uint8 *image_temp;

    TFT180_CS(0);
    tft180_set_region(x, y, x + dis_width - 1, y + dis_height - 1);

    for(j = 0; j < dis_height; j++)
    {
        image_temp = image + j * height / dis_height * width;
        for(i = 0; i < dis_width; i++)
        {
            temp = *(image_temp + i * width / dis_width);
            if(threshold == 0)
            {
                color = (0x001f & ((temp) >> 3)) << 11;
                color = color | (((0x003f) & ((temp) >> 2)) << 5);
                color = color | (0x001f & ((temp) >> 3));
            }
            else if(temp < threshold)
            {
                color = RGB565_BLACK;
            }
            else
            {
                color = RGB565_WHITE;
            }
            tft180_write_16bit_data(color);
        }
    }
    tft180_spi_wait_idle();
    TFT180_CS(1);
}

void tft180_show_rgb565_image(uint16 x, uint16 y, const uint16 *image, uint16 width, uint16 height, uint16 dis_width, uint16 dis_height, uint8 color_mode)
{
    if (x >= tft180_x_max || y >= tft180_y_max || image == NULL) return;

    uint32 i = 0, j = 0;
    const uint16 *image_temp;

    TFT180_CS(0);
    tft180_set_region(x, y, x + dis_width - 1, y + dis_height - 1);

    for(j = 0; j < dis_height; j++)
    {
        image_temp = image + j * height / dis_height * width;
        for(i = 0; i < dis_width; i++)
        {
            uint16 pixel = *(image_temp + i * width / dis_width);
            if (color_mode)
            {
                tft180_write_16bit_data(pixel);
            }
            else
            {
                tft180_write_8bit_data((uint8_t)(pixel & 0xFF));
                tft180_write_8bit_data((uint8_t)(pixel >> 8));
            }
        }
    }
    tft180_spi_wait_idle();
    TFT180_CS(1);
}

void tft180_show_wave(uint16 x, uint16 y, const uint16 *wave, uint16 width, uint16 value_max, uint16 dis_width, uint16 dis_value_max)
{
    if (x >= tft180_x_max || y >= tft180_y_max || wave == NULL) return;

    uint32 i = 0, j = 0;
    uint32 width_index = 0, value_max_index = 0;

    TFT180_CS(0);
    tft180_set_region(x, y, x + dis_width - 1, y + dis_value_max - 1);
    for(j = 0; j < dis_value_max; j++)
    {
        for(i = 0; i < dis_width; i++)
        {
            tft180_write_16bit_data(tft180_bgcolor);
        }
    }
    tft180_spi_wait_idle();
    TFT180_CS(1);

    for(i = 0; i < dis_width; i++)
    {
        width_index = i * width / dis_width;
        value_max_index = *(wave + width_index) * (dis_value_max - 1) / value_max;
        tft180_draw_point(i + x, (dis_value_max - 1) - value_max_index + y, tft180_pencolor);
    }
}

void tft180_show_chinese(uint16 x, uint16 y, uint8 size, const uint8 *chinese_buffer, uint8 number, const uint16 color)
{
    if (x >= tft180_x_max || y >= tft180_y_max || chinese_buffer == NULL) return;

    TFT180_CS(0);
    for (uint8 n = 0; n < number; n++)
    {
        const uint8 *single_char_bitmap = chinese_buffer + n * 32;
        tft180_draw_chinese_16x16(x + n * size, y, single_char_bitmap, color);
    }
    tft180_spi_wait_idle();
    TFT180_CS(1);
}

// --------------------------- 直观中文字符串接口实现 ---------------------------

void tft180_show_chinese_str(uint16 x, uint16 y, const char *str, uint16 color)
{
    if (str == NULL) return;

    uint16 curr_x = x;
    const char *p = str;

    while (*p != '\0')
    {
        if (curr_x >= tft180_x_max) break;

        unsigned char c = (unsigned char)*p;

        // 1. ASCII 字符 (1 字节)
        if (c < 0x80)
        {
            if (c >= ' ' && c <= '~')
            {
                uint16 prev_pen = tft180_pencolor;
                tft180_pencolor = color;
                tft180_show_char(curr_x, y, (char)c);
                tft180_pencolor = prev_pen;
            }
            curr_x += (tft180_display_font == TFT180_6X8_FONT) ? 6 : 8;
            p++;
        }
        else
        {
            // 2. 中文字符处理：【强制优先匹配 3字节 UTF-8】，匹配成功后才后移 3 字节！
            int match_len = 0;
            const uint8 *found_bitmap = NULL;

            // 优先匹配 UTF-8 (3 字节: 0xE0~0xEF)
            if (c >= 0xE0 && (unsigned char)p[1] != 0 && (unsigned char)p[2] != 0)
            {
                for (size_t k = 0; k < sizeof(chinese_db) / sizeof(chinese_db[0]); k++)
                {
                    if ((unsigned char)p[0] == chinese_db[k].utf8_bytes[0] &&
                        (unsigned char)p[1] == chinese_db[k].utf8_bytes[1] &&
                        (unsigned char)p[2] == chinese_db[k].utf8_bytes[2])
                    {
                        found_bitmap = chinese_db[k].bitmap;
                        match_len = 3;
                        break;
                    }
                }
            }

            // 若 3 字节 UTF-8 未匹配成功，再尝试 GBK (2 字节)
            if (found_bitmap == NULL && (unsigned char)p[1] != 0)
            {
                for (size_t k = 0; k < sizeof(chinese_db) / sizeof(chinese_db[0]); k++)
                {
                    if ((unsigned char)p[0] == chinese_db[k].gbk_bytes[0] &&
                        (unsigned char)p[1] == chinese_db[k].gbk_bytes[1])
                    {
                        found_bitmap = chinese_db[k].bitmap;
                        match_len = 2;
                        break;
                    }
                }
            }

            if (found_bitmap != NULL)
            {
                tft180_draw_chinese_16x16(curr_x, y, found_bitmap, color);
                curr_x += 16;
                p += match_len;
            }
            else
            {
                p += (c >= 0xE0) ? 3 : 2;
                curr_x += 16;
            }
        }
    }
}

void tft180_init(void)
{
    tft180_set_dir(tft180_display_dir);
    tft180_set_color(tft180_pencolor, tft180_bgcolor);

    TFT180_RST(0);
    delay_ms(10);

    TFT180_RST(1);
    delay_ms(120);
    TFT180_CS(0);

    tft180_write_index(0x11);
    delay_ms(120);

    tft180_write_index(0xB1);
    tft180_write_8bit_data(0x01);
    tft180_write_8bit_data(0x2C);
    tft180_write_8bit_data(0x2D);

    tft180_write_index(0xB2);
    tft180_write_8bit_data(0x01);
    tft180_write_8bit_data(0x2C);
    tft180_write_8bit_data(0x2D);

    tft180_write_index(0xB3);
    tft180_write_8bit_data(0x01);
    tft180_write_8bit_data(0x2C);
    tft180_write_8bit_data(0x2D);
    tft180_write_8bit_data(0x01);
    tft180_write_8bit_data(0x2C);
    tft180_write_8bit_data(0x2D);

    tft180_write_index(0xB4);
    tft180_write_8bit_data(0x07);

    tft180_write_index(0xC0);
    tft180_write_8bit_data(0xA2);
    tft180_write_8bit_data(0x02);
    tft180_write_8bit_data(0x84);
    tft180_write_index(0xC1);
    tft180_write_8bit_data(0xC5);

    tft180_write_index(0xC2);
    tft180_write_8bit_data(0x0A);
    tft180_write_8bit_data(0x00);

    tft180_write_index(0xC3);
    tft180_write_8bit_data(0x8A);
    tft180_write_8bit_data(0x2A);
    tft180_write_index(0xC4);
    tft180_write_8bit_data(0x8A);
    tft180_write_8bit_data(0xEE);

    tft180_write_index(0xC5);
    tft180_write_8bit_data(0x0E);

    tft180_write_index(0x36);
    switch(tft180_display_dir)
    {
        case TFT180_PORTAIT:        tft180_write_8bit_data(1<<7 | 1<<6 | 0<<5);  break;
        case TFT180_PORTAIT_180:    tft180_write_8bit_data(0<<7 | 0<<6 | 0<<5);  break;
        case TFT180_CROSSWISE:      tft180_write_8bit_data(1<<7 | 0<<6 | 1<<5);  break;
        case TFT180_CROSSWISE_180:  tft180_write_8bit_data(0<<7 | 1<<6 | 1<<5);  break;
    }

    tft180_write_index(0xe0);
    tft180_write_8bit_data(0x0f);
    tft180_write_8bit_data(0x1a);
    tft180_write_8bit_data(0x0f);
    tft180_write_8bit_data(0x18);
    tft180_write_8bit_data(0x2f);
    tft180_write_8bit_data(0x28);
    tft180_write_8bit_data(0x20);
    tft180_write_8bit_data(0x22);
    tft180_write_8bit_data(0x1f);
    tft180_write_8bit_data(0x1b);
    tft180_write_8bit_data(0x23);
    tft180_write_8bit_data(0x37);
    tft180_write_8bit_data(0x00);
    tft180_write_8bit_data(0x07);
    tft180_write_8bit_data(0x02);
    tft180_write_8bit_data(0x10);

    tft180_write_index(0xe1);
    tft180_write_8bit_data(0x0f);
    tft180_write_8bit_data(0x1b);
    tft180_write_8bit_data(0x0f);
    tft180_write_8bit_data(0x17);
    tft180_write_8bit_data(0x33);
    tft180_write_8bit_data(0x2c);
    tft180_write_8bit_data(0x29);
    tft180_write_8bit_data(0x2e);
    tft180_write_8bit_data(0x30);
    tft180_write_8bit_data(0x30);
    tft180_write_8bit_data(0x39);
    tft180_write_8bit_data(0x3f);
    tft180_write_8bit_data(0x00);
    tft180_write_8bit_data(0x07);
    tft180_write_8bit_data(0x03);
    tft180_write_8bit_data(0x10);

    tft180_write_index(0x2a);
    tft180_write_8bit_data(0x00);
    tft180_write_8bit_data(0x00);
    tft180_write_8bit_data(0x00);
    tft180_write_8bit_data(128 - 1);

    tft180_write_index(0x2b);
    tft180_write_8bit_data(0x00);
    tft180_write_8bit_data(0x00);
    tft180_write_8bit_data(0x00);
    tft180_write_8bit_data(160 - 1);

    tft180_write_index(0xF0);
    tft180_write_8bit_data(0x01);
    tft180_write_index(0xF6);
    tft180_write_8bit_data(0x00);

    tft180_write_index(0x3A);
    tft180_write_8bit_data(0x05);
    tft180_write_index(0x29);

    tft180_spi_wait_idle();
    TFT180_CS(1);

    tft180_clear();
}
